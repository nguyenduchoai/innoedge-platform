## components-hw/innoedge_audio/Kconfig
```kconfig
menu "InnoEdge audio (I2S mic + speaker)"

# Chân I2S mặc định -1 = kênh tắt: build/boot được khi chưa đấu dây.
# Bộ tham chiếu: INMP441 (mic) + MAX98357A (amp), hai cổng I2S riêng.

config IE_AUDIO_MIC_BCLK_GPIO
    int "Mic I2S BCLK (SCK) GPIO (-1 = không có mic)"
    default -1
config IE_AUDIO_MIC_WS_GPIO
    int "Mic I2S WS (LRCLK) GPIO"
    default -1
config IE_AUDIO_MIC_DIN_GPIO
    int "Mic I2S DATA (SD) GPIO"
    default -1

config IE_AUDIO_SPK_BCLK_GPIO
    int "Speaker I2S BCLK GPIO (-1 = không có loa)"
    default -1
config IE_AUDIO_SPK_WS_GPIO
    int "Speaker I2S WS (LRCLK) GPIO"
    default -1
config IE_AUDIO_SPK_DOUT_GPIO
    int "Speaker I2S DATA (DIN của amp) GPIO"
    default -1

config IE_AUDIO_MIC_GAIN_SHIFT
    int "Khuếch đại mic (dịch bit, 0-8)"
    default 4
    help
      INMP441 xuất 24-bit trong khung 32-bit, biên độ nhỏ. Dịch trái N bit
      trước khi cắt về 16-bit. 4 là hợp lý cho nói cách mic 30cm; méo thì giảm.

config IE_AUDIO_MAX_LISTEN_SEC
    int "Trần một lần thu (giây)"
    default 15
    help
      Giữ nút quá lâu (kẹt nút, bé nghịch) không được biến thành stream vô tận.

endmenu
```

## components-hw/innoedge_hw/Kconfig
```kconfig
menu "InnoEdge HW drivers (mẫu)"

# Tham số PHẦN CỨNG của driver mẫu. Mặc định GPIO = -1 (tắt): build và boot
# được khi chưa đấu dây, driver chỉ ghi log. Project đặt chân thật trong
# sdkconfig.defaults của mình (xem examples/06, examples/08) — KHÔNG sửa ở đây.

comment "Đầu đọc xu / bill (pulse_input)"

config INNOEDGE_COIN_PULSE_GPIO
    int "Coin acceptor pulse GPIO (-1 = tắt)"
    default -1

config INNOEDGE_BILL_PULSE_GPIO
    int "Bill acceptor pulse GPIO (-1 = tắt)"
    default -1

config INNOEDGE_COIN_PULSE_PCA9554_P0
    bool "Đọc xung xu qua IO-expander PCA9554 P0 thay vì GPIO"
    default n

config INNOEDGE_COIN_VND_PER_PULSE
    int "VND mỗi xung xu (0 = gửi SỐ XU, cloud tự quy đổi)"
    default 0

config INNOEDGE_BILL_VND_PER_PULSE
    int "VND mỗi xung bill"
    default 10000

config INNOEDGE_PULSE_MIN_MS
    int "Chống dội: độ rộng xung tối thiểu (ms)"
    default 35

config INNOEDGE_PULSE_GAP_MS
    int "Khoảng lặng kết thúc một chuỗi xung (ms)"
    default 300

comment "Relay nhả tiền (relay_control)"

config INNOEDGE_RELAY_GPIO
    int "Relay nhả tiền/credit GPIO (-1 = tắt)"
    default -1

config INNOEDGE_RELAY_PULSE_MS
    int "Độ rộng xung relay (ms)"
    default 80

config INNOEDGE_RELAY_PULSE_GAP_MS
    int "Khoảng cách giữa hai xung relay (ms)"
    default 120

config INNOEDGE_DISPENSE_VND_PER_PULSE
    int "VND mỗi xung khi nhả tiền (0 = dùng bill rate)"
    default 0

config INNOEDGE_DISPENSE_MAX_PULSES
    int "Trần an toàn: số xung tối đa mỗi lệnh dispense"
    default 200

comment "Rửa xe (wash_control) — 4 relay, -1 = tắt"

config INNOEDGE_WASH_GPIO_WATER
    int "WATER (xịt nước) relay GPIO"
    default -1

config INNOEDGE_WASH_GPIO_FOAM
    int "FOAM (phun bọt) relay GPIO"
    default -1

config INNOEDGE_WASH_GPIO_AIR
    int "AIR (nén khí) relay GPIO"
    default -1

config INNOEDGE_WASH_GPIO_VACUUM
    int "VACUUM (hút bụi) relay GPIO"
    default -1

config INNOEDGE_WASH_WATER_SENSOR_GPIO
    int "Cảm biến có nước (active-low; -1 = không lắp)"
    default -1
    help
      Bơm chạy khô là hỏng bơm. Có cảm biến thì wash_control tự chặn và báo
      cảnh báo no_water lên cloud.

config INNOEDGE_WASH_MAX_ACTIVATION_SEC
    int "Watchdog: một lần bật relay tối đa (giây)"
    default 600

config INNOEDGE_WASH_MASTER_MARGIN_SEC
    int "Thời gian phiên dư ra ngoài tổng ngân sách (giây)"
    default 120

endmenu
```

## examples/06-coin-relay/main/Kconfig.projbuild
```kconfig
menu "Board — coin-op"

# Tham số PHẦN CỨNG thuộc lớp board/application, KHÔNG thuộc SDK.
# Bo khác = sửa file này, không đụng SDK.

config GTEK_COIN_PULSE_GPIO
    int "Coin acceptor pulse GPIO (-1 = tat)"
    default 4

config GTEK_BILL_PULSE_GPIO
    int "Bill acceptor pulse GPIO (-1 = tat)"
    default -1

config GTEK_COIN_PULSE_PCA9554_P0
    bool "Doc xung xu qua IO-expander PCA9554 P0 thay vi GPIO"
    default n

config GTEK_COIN_VND_PER_PULSE
    int "VND moi xung xu (0 = gui SO XU, cloud tu quy doi)"
    default 0

config GTEK_BILL_VND_PER_PULSE
    int "VND moi xung bill"
    default 10000

config GTEK_PULSE_MIN_MS
    int "Chong doi: do rong xung toi thieu (ms)"
    default 35

config GTEK_PULSE_GAP_MS
    int "Khoang lang ket thuc mot chuoi xung (ms)"
    default 300

config GTEK_RELAY_GPIO
    int "Relay nha tien/credit GPIO (-1 = tat)"
    default 42

config GTEK_RELAY_PULSE_MS
    int "Do rong xung relay (ms)"
    default 80

config GTEK_RELAY_PULSE_GAP_MS
    int "Khoang cach giua hai xung relay (ms)"
    default 120

config GTEK_DISPENSE_VND_PER_PULSE
    int "VND moi xung khi nha tien (0 = dung bill rate)"
    default 0

config GTEK_DISPENSE_MAX_PULSES
    int "Tran an toan: so xung toi da moi lenh dispense"
    default 200

comment "Kenh relay rua xe — example 08 dung, o day de -1"

config GTEK_WASH_GPIO_WATER
    int "WATER relay GPIO"
    default -1

config GTEK_WASH_GPIO_FOAM
    int "FOAM relay GPIO"
    default -1

config GTEK_WASH_GPIO_AIR
    int "AIR relay GPIO"
    default -1

config GTEK_WASH_GPIO_VACUUM
    int "VACUUM relay GPIO"
    default -1

endmenu
```

## examples/06-coin-relay/sdkconfig.defaults
```kconfig
CONFIG_PARTITION_TABLE_CUSTOM=y
CONFIG_PARTITION_TABLE_CUSTOM_FILENAME="partitions.csv"
CONFIG_PARTITION_TABLE_OFFSET=0x8000
CONFIG_BOOTLOADER_APP_ROLLBACK_ENABLE=y
CONFIG_ESPTOOLPY_FLASHSIZE_4MB=y
CONFIG_FREERTOS_HZ=1000
CONFIG_ESP_MAIN_TASK_STACK_SIZE=8192

CONFIG_ESP_HTTP_CLIENT_ENABLE_HTTPS=y
CONFIG_ESP_HTTPS_OTA_ALLOW_HTTP=n
CONFIG_MBEDTLS_CERTIFICATE_BUNDLE=y

CONFIG_BT_ENABLED=y
CONFIG_BT_BLUEDROID_ENABLED=n
CONFIG_BT_NIMBLE_ENABLED=y
CONFIG_BT_NIMBLE_MAX_CONNECTIONS=1
CONFIG_BT_NIMBLE_ROLE_CENTRAL=n
CONFIG_BT_NIMBLE_ROLE_PERIPHERAL=y
CONFIG_BT_NIMBLE_ROLE_BROADCASTER=y
CONFIG_BT_NIMBLE_ROLE_OBSERVER=n
CONFIG_BT_NIMBLE_ATT_PREFERRED_MTU=256

CONFIG_GTEK_SERVER_BASE_URL="https://cloud.example.com"
CONFIG_GTEK_FW_VERSION="0.1.3"

CONFIG_INNOEDGE_COIN_PULSE_GPIO=4
CONFIG_INNOEDGE_RELAY_GPIO=42
```

## examples/08-carwash/main/Kconfig.projbuild
```kconfig
menu "Board — car wash"

# Tham số PHẦN CỨNG. Bo khác = sửa file này, không đụng SDK.

config GTEK_WASH_GPIO_WATER
    int "WATER (xit nuoc) relay GPIO (-1 = tat)"
    default 4

config GTEK_WASH_GPIO_FOAM
    int "FOAM (phun bot) relay GPIO (-1 = tat)"
    default 5

config GTEK_WASH_GPIO_AIR
    int "AIR (nen khi) relay GPIO (-1 = tat)"
    default 6

config GTEK_WASH_GPIO_VACUUM
    int "VACUUM (hut bui) relay GPIO (-1 = tat)"
    default 7

config GTEK_WASH_WATER_SENSOR_GPIO
    int "Cam bien co nuoc (active-low; -1 = khong lap)"
    default -1
    help
      Bom chay kho la hong bom. Co cam bien thi wash_control tu chan va bao
      canh bao no_water len cloud.

config GTEK_WASH_MAX_ACTIVATION_SEC
    int "Watchdog: mot lan bat relay toi da (giay)"
    default 600
    help
      Luoi an toan cuoi cung: relay ket ON qua nguong nay se bi cat.

config GTEK_WASH_MASTER_MARGIN_SEC
    int "Thoi gian phien du ra ngoai tong ngan sach (giay)"
    default 120

config GTEK_RELAY_GPIO
    int "Relay nha tien/credit GPIO (-1 = tat, may rua khong dung)"
    default -1

config GTEK_RELAY_PULSE_MS
    int "Do rong xung relay (ms)"
    default 80

endmenu
```

## examples/11-voice-assistant/sdkconfig.defaults
```kconfig
CONFIG_PARTITION_TABLE_CUSTOM=y
CONFIG_PARTITION_TABLE_CUSTOM_FILENAME="partitions.csv"
CONFIG_PARTITION_TABLE_OFFSET=0x8000
CONFIG_BOOTLOADER_APP_ROLLBACK_ENABLE=y
CONFIG_ESPTOOLPY_FLASHSIZE_4MB=y
CONFIG_FREERTOS_HZ=1000
CONFIG_ESP_MAIN_TASK_STACK_SIZE=8192

CONFIG_ESP_HTTP_CLIENT_ENABLE_HTTPS=y
CONFIG_ESP_HTTPS_OTA_ALLOW_HTTP=n
CONFIG_MBEDTLS_CERTIFICATE_BUNDLE=y

CONFIG_BT_ENABLED=y
CONFIG_BT_BLUEDROID_ENABLED=n
CONFIG_BT_NIMBLE_ENABLED=y
CONFIG_BT_NIMBLE_MAX_CONNECTIONS=1
CONFIG_BT_NIMBLE_ROLE_CENTRAL=n
CONFIG_BT_NIMBLE_ROLE_PERIPHERAL=y
CONFIG_BT_NIMBLE_ROLE_BROADCASTER=y
CONFIG_BT_NIMBLE_ROLE_OBSERVER=n
CONFIG_BT_NIMBLE_ATT_PREFERRED_MTU=256

CONFIG_INNOEDGE_SERVER_BASE_URL="https://cloud.example.com"

CONFIG_IE_AUDIO_MIC_BCLK_GPIO=4
CONFIG_IE_AUDIO_MIC_WS_GPIO=5
CONFIG_IE_AUDIO_MIC_DIN_GPIO=6
CONFIG_IE_AUDIO_SPK_BCLK_GPIO=15
CONFIG_IE_AUDIO_SPK_WS_GPIO=16
CONFIG_IE_AUDIO_SPK_DOUT_GPIO=7
```
